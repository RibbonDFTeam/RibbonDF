## project/test/src/zlog_test/Kconfig
```kconfig
config MODULE_ZLOG_TEST_ENABLE
    bool "zlog_test enalbe"
    default n
    help
      Enable zlog_test.
    select MODULE_ZLOG_ENABLE
```

## third_lib/EasyLogger/Kconfig
```kconfig
config MODULE_EASYLOGGER_ENABLE
    bool "Enable EasyLogger"
    default n
    help
      Enable EasyLogger.

config MODULE_EASYLOG_PLUGIN_FILE_ENABLE
    bool "Enable file plugin"
    default y
    help
      Enable file plugin
    depends on MODULE_EASYLOGGER_ENABLE

config MODULE_EASYLOG_PLUGIN_FLASH_ENABLE
    bool "Enable flash plugin"
    default n
    help
      Enable flash plugin
    depends on MODULE_EASYLOGGER_ENABLE
    
```

## third_lib/Kconfig
```kconfig
menu "Third lib Configuration"
osource "${RibbonDF_PROJECT_DIR}/../../third_lib/*/Kconfig"
endmenu
```

## third_lib/Melon/Kconfig
```kconfig
config MODULE_MELON_ENABLE
    bool "Enable Melon"
    default n
    help
      Enable Melon.
```

## third_lib/cJSON/Kconfig
```kconfig
config MODULE_CJSON_ENABLE
    bool "Enable cJSON"
    default n
    help
      Enable cJSON.

 config MODULE_CJSON_SHARED
    bool "build cJSON shared lib"
    default y
    help
      Enable build cJSON shared lib.
    depends on MODULE_CJSON_ENABLE
```

## third_lib/fdbus/Kconfig
```kconfig
config MODULE_FDBUS_ENABLE
    bool "Enable fdbus"
    default n
    help
      Enable fdbus.
```

## third_lib/gtest/Kconfig
```kconfig
config MODULE_GTEST_ENABLE
    bool "Enable gtest"
    default n
    help
      Enable gtest.
```

## third_lib/jsoncpp/Kconfig
```kconfig
config MODULE_JSONCPP_ENABLE
    bool "Enable jsoncpp"
    default n
    help
      Enable jsoncpp.
```

## third_lib/libprotobuf/Kconfig
```kconfig
config MODULE_LIBPROTOBUF_ENABLE
    bool "Enable protobuf library"
    default n
    help
      Enable protobuf library.
```

## third_lib/mbedtls/Kconfig
```kconfig
config MODULE_MBEDTLS_ENABLE
    bool "Enable mbedtls"
    default n
    help
      Enable mbedtls.
```

## third_lib/nng/Kconfig
```kconfig
config MODULE_NNG_ENABLE
    bool "Enable nng"
    default n
    help
      Enable nng.
```

## third_lib/securec/Kconfig
```kconfig
config MODULE_SECUREC_ENABLE
    bool "Enable securec"
    default n
    help
      Enable securec.
```

## third_lib/ulog/Kconfig
```kconfig
config MODULE_ULOG_ENABLE
    bool "Enable ulog"
    default n
    help
      Enable ulog.
```

## third_lib/uuid/Kconfig
```kconfig
config MODULE_UUID_ENABLE
    bool "Enable uuid"
    default n
    help
      Enable uuid.
```

## third_lib/valgrind/Kconfig
```kconfig
config MODULE_VALGRIND_ENABLE
    bool "Enable valgrind"
    default n
    help
      Enable valgrind.
```

## third_lib/zlog/Kconfig
```kconfig
config MODULE_ZLOG_ENABLE
    bool "Enable zlog"
    default n
    help
      Enable zlog.
```
