## Kconfig
```kconfig
source "${RibbonDF_PROJECT_DIR}/../Kconfig"
source "${RibbonDF_PROJECT_DIR}/../../components/Kconfig"
source "${RibbonDF_PROJECT_DIR}/../../third_lib/Kconfig"
```

## components/Kconfig
```kconfig
menu "components Configuration"
osource "${RibbonDF_PROJECT_DIR}/../../components/*/Kconfig"
endmenu
```

## components/example_app/Kconfig
```kconfig
config MODULE_EXAMPLE_APP_ENABLE
    bool "Enable Example App"
    default n
    help
      Enable Example App.
    select MODULE_EXAMPLE_COMPONENT_ENABLE
```

## components/example_component/Kconfig
```kconfig
config MODULE_EXAMPLE_COMPONENT_ENABLE
    bool "Enable example component"
    default n
    help
      Enable example component.
```

## components/nlohmann_json/Kconfig
```kconfig
config MODULE_NLOHMANN_JSON_ENABLE
    bool "nlohmann_json enalbe"
    default n
    help
      Enable nlohmann_json.
```

## components/rblog/Kconfig
```kconfig
config MODULE_RBLOG_ENABLE
    bool "rblog enalbe"
    default n
    help
      Enable rblog.

menu "rblog config"
    depends on MODULE_RBLOG_ENABLE

choice MODULE_RBLOG_BASE_LOG_COMPONENT
    prompt "base log componnet of rblog"
    default MODULE_RBLOG_BASE_LOG_ZLOG
    depends on MODULE_RBLOG_ENABLE

config MODULE_RBLOG_BASE_LOG_ZLOG
    bool "use zlog"
    select MODULE_ZLOG_ENABLE

config MODULE_RBLOG_BASE_LOG_EASYLOGGER
    bool "use EasyLogger"
    select MODULE_EASYLOGGER_ENABLE
endchoice

config MODULE_RBLOG_ZLOG_CFG_FILE_PATH
    string "zlog config file path"
    default ""
    depends on MODULE_RBLOG_BASE_LOG_ZLOG
endmenu
```

## components/unit_test/Kconfig
```kconfig
config MODULE_UNIT_TEST_ENABLE
    bool "Enable unit test"
    default n
    help
      Enable unit test.


choice MODULE_UNIT_TEST_BASE_COMPONENT
    prompt "unit test base componnet"
    default MODULE_UNIT_TEST_BASE_GTEST
    depends on MODULE_UNIT_TEST_ENABLE

config MODULE_UNIT_TEST_BASE_GTEST
    bool "use gtest"
    select MODULE_GTEST_ENABLE
endchoice
```

## project/test/src/Kconfig
```kconfig
menu "Project Src Configuration"
osource "${RibbonDF_PROJECT_DIR}/src/*/Kconfig"
endmenu
```

## project/test/src/cjson_test/Kconfig
```kconfig
config MODULE_CJSON_TEST_ENABLE
    bool "cJSON test enalbe"
    default n
    help
      Enable cJSON test.
    select MODULE_CJSON_ENABLE

menu "cjson_test config"
    depends on MODULE_CJSON_TEST_ENABLE

    config MODULE_CJSON_UNIT_TEST_ENABLE
      bool "enalbe cjson unit test"
      default n
      select MODULE_GTEST_ENABLE

    config MODULE_CJSON_UNIT_TEST_COVERAGE_STAT_ENABLE
      bool "enable cjson unit test coverage statistics"
      default n
      depends on MODULE_CJSON_UNIT_TEST_ENABLE
endmenu
```

## project/test/src/cmake_test/Kconfig
```kconfig
config MODULE_CMAKE_TEST_ENABLE
    bool "cmake test enalbe"
    default n
    help
      Enable cmake test.
```

## project/test/src/easylogger_test/Kconfig
```kconfig
config MODULE_EASYLOGGER_TEST_ENABLE
    bool "EasyLogger test enalbe"
    default n
    help
      Enable EasyLogger test.
    select MODULE_EASYLOGGER_ENABLE
```

## project/test/src/event_fd/Kconfig
```kconfig
config MODULE_EVENT_FD_ENABLE
    bool "event_fd enalbe"
    default n
    help
      Enable event_fd.
```

## project/test/src/fdbus_client/Kconfig
```kconfig
config MODULE_FDBUS_CLIENT_ENABLE
    bool "fdbus client enalbe"
    default n
    help
      Enable fdbus client.
    select MODULE_FDBUS_ENABLE
```

## project/test/src/fdbus_server/Kconfig
```kconfig
config MODULE_FDBUS_SERVER_ENABLE
    bool "fdbus server enalbe"
    default n
    help
      Enable fdbus server.
    select MODULE_FDBUS_ENABLE
```

## project/test/src/gtest_test/Kconfig
```kconfig
config MODULE_GTEST_TEST_ENABLE
    bool "gtest test enalbe"
    default n
    help
      Enable gtest test.
    select MODULE_GTEST_ENABLE
```

## project/test/src/libc_test/Kconfig
```kconfig
config MODULE_LIBC_TEST_ENABLE
    bool "libc_test enalbe"
    default n
    help
      Enable libc_test.

choice LIBC_SUBSTITUTE
    prompt "Libc func subtitute mode"
    default LIBC_SUBSTITUTE_WRAP
    depends on MODULE_LIBC_TEST_ENABLE

config LIBC_SUBSTITUTE_WRAP
    bool "use -Wl,--wrap="

config LIBC_SUBSTITUTE_ALIAS
    bool "use __attribute__((alias))"

endchoice
```

## project/test/src/main/Kconfig
```kconfig
config MODULE_MAIN_ENABLE
    bool "main app enalbe"
    default n
    help
      Enable main app.
```

## project/test/src/mbed_sign/Kconfig
```kconfig
config MODULE_MBED_SIGN_ENABLE
    bool "mbed_sign enalbe"
    default n
    help
      Enable mbed_sign.
    select MODULE_MBEDTLS_ENABLE
```

## project/test/src/melon_test/Kconfig
```kconfig
config MODULE_MELON_TEST_ENABLE
    bool "melon_test enalbe"
    default n
    help
      Enable melon_test.
    select MODULE_MELON_ENABLE
```

## project/test/src/nlohmann_json_test/Kconfig
```kconfig
config MODULE_NLOHMANN_JSON_TEST_ENABLE
    bool "nlohmann_json_test enalbe"
    default n
    help
      Enable nlohmann_json_test.
    select MODULE_NLOHMANN_JSON_ENABLE
```

## project/test/src/proto_test/Kconfig
```kconfig
config MODULE_PROTO_TEST_ENABLE
    bool "proto_test app enalbe"
    default n
    help
      Enable proto_test app.
    select MODULE_LIBPROTOBUF_ENABLE
    select MODULE_CJSON_ENABLE
```

## project/test/src/rblog_test/Kconfig
```kconfig
config MODULE_RBLOG_TEST_ENABLE
    bool "rblog_test enalbe"
    default n
    help
      Enable rblog_test.
    select MODULE_RBLOG_ENABLE
```

## project/test/src/securec_test/Kconfig
```kconfig
config MODULE_SECUREC_TEST_ENABLE
    bool "securec_test enalbe"
    default n
    help
      Enable securec_test app.
    select MODULE_SECUREC_ENABLE
```

## project/test/src/uuid_test/Kconfig
```kconfig
config MODULE_UUID_TEST_ENABLE
    bool "uuid_test enalbe"
    default n
    help
      Enable uuid_test.
    select MODULE_UUID_ENABLE
```
